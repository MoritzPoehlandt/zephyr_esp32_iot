## build/Kconfig/arch/Kconfig
```kconfig
# Load arch Kconfig descriptions.
osource "/Users/moritzpohlandt/zephyrproject/zephyr/arch/x86/Kconfig"
osource "/Users/moritzpohlandt/zephyrproject/zephyr/arch/xtensa/Kconfig"
osource "/Users/moritzpohlandt/zephyrproject/zephyr/arch/sparc/Kconfig"
osource "/Users/moritzpohlandt/zephyrproject/zephyr/arch/riscv/Kconfig"
osource "/Users/moritzpohlandt/zephyrproject/zephyr/arch/posix/Kconfig"
osource "/Users/moritzpohlandt/zephyrproject/zephyr/arch/nios2/Kconfig"
osource "/Users/moritzpohlandt/zephyrproject/zephyr/arch/mips/Kconfig"
osource "/Users/moritzpohlandt/zephyrproject/zephyr/arch/arm64/Kconfig"
osource "/Users/moritzpohlandt/zephyrproject/zephyr/arch/arm/Kconfig"
osource "/Users/moritzpohlandt/zephyrproject/zephyr/arch/arc/Kconfig"
```

## build/Kconfig/soc/Kconfig.sysbuild
```kconfig
# Load SoC sysbuild Kconfig descriptions.
osource "/Users/moritzpohlandt/zephyrproject/zephyr/soc/xlnx/zynqmp/Kconfig.sysbuild"
osource "/Users/moritzpohlandt/zephyrproject/zephyr/soc/xlnx/zynq7000/Kconfig.sysbuild"
osource "/Users/moritzpohlandt/zephyrproject/zephyr/soc/xen/Kconfig.sysbuild"
osource "/Users/moritzpohlandt/zephyrproject/zephyr/soc/ti/simplelink/Kconfig.sysbuild"
osource "/Users/moritzpohlandt/zephyrproject/zephyr/soc/ti/lm3s6965/Kconfig.sysbuild"
osource "/Users/moritzpohlandt/zephyrproject/zephyr/soc/ti/k3/Kconfig.sysbuild"
osource "/Users/moritzpohlandt/zephyrproject/zephyr/soc/telink/tlsr/Kconfig.sysbuild"
osource "/Users/moritzpohlandt/zephyrproject/zephyr/soc/starfive/jh71xx/Kconfig.sysbuild"
osource "/Users/moritzpohlandt/zephyrproject/zephyr/soc/st/stm32/Kconfig.sysbuild"
osource "/Users/moritzpohlandt/zephyrproject/zephyr/soc/snps/qemu_arc/Kconfig.sysbuild"
osource "/Users/moritzpohlandt/zephyrproject/zephyr/soc/snps/nsim/arc_v/Kconfig.sysbuild"
osource "/Users/moritzpohlandt/zephyrproject/zephyr/soc/snps/nsim/arc_classic/Kconfig.sysbuild"
osource "/Users/moritzpohlandt/zephyrproject/zephyr/soc/snps/hsdk4xd/Kconfig.sysbuild"
osource "/Users/moritzpohlandt/zephyrproject/zephyr/soc/snps/hsdk/Kconfig.sysbuild"
osource "/Users/moritzpohlandt/zephyrproject/zephyr/soc/snps/emsk/Kconfig.sysbuild"
osource "/Users/moritzpohlandt/zephyrproject/zephyr/soc/snps/emsdp/Kconfig.sysbuild"
osource "/Users/moritzpohlandt/zephyrproject/zephyr/soc/snps/arc_iot/Kconfig.sysbuild"
osource "/Users/moritzpohlandt/zephyrproject/zephyr/soc/silabs/Kconfig.sysbuild"
osource "/Users/moritzpohlandt/zephyrproject/zephyr/soc/sifive/sifive_freedom/Kconfig.sysbuild"
osource "/Users/moritzpohlandt/zephyrproject/zephyr/soc/sensry/Kconfig.sysbuild"
osource "/Users/moritzpohlandt/zephyrproject/zephyr/soc/rockchip/Kconfig.sysbuild"
osource "/Users/moritzpohlandt/zephyrproject/zephyr/soc/renode/riscv_virtual/Kconfig.sysbuild"
osource "/Users/moritzpohlandt/zephyrproject/zephyr/soc/renode/cortex_r8_virtual/Kconfig.sysbuild"
osource "/Users/moritzpohlandt/zephyrproject/zephyr/soc/renesas/smartbond/Kconfig.sysbuild"
osource "/Users/moritzpohlandt/zephyrproject/zephyr/soc/renesas/rzt2m/Kconfig.sysbuild"
osource "/Users/moritzpohlandt/zephyrproject/zephyr/soc/renesas/rcar/Kconfig.sysbuild"
osource "/Users/moritzpohlandt/zephyrproject/zephyr/soc/renesas/ra/Kconfig.sysbuild"
osource "/Users/moritzpohlandt/zephyrproject/zephyr/soc/raspberrypi/Kconfig.sysbuild"
osource "/Users/moritzpohlandt/zephyrproject/zephyr/soc/quicklogic/eos_s3/Kconfig.sysbuild"
osource "/Users/moritzpohlandt/zephyrproject/zephyr/soc/qemu/virt_riscv/Kconfig.sysbuild"
osource "/Users/moritzpohlandt/zephyrproject/zephyr/soc/qemu/malta/Kconfig.sysbuild"
osource "/Users/moritzpohlandt/zephyrproject/zephyr/soc/openisa/rv32m1/Kconfig.sysbuild"
osource "/Users/moritzpohlandt/zephyrproject/zephyr/soc/nxp/s32/Kconfig.sysbuild"
osource "/Users/moritzpohlandt/zephyrproject/zephyr/soc/nxp/rw/Kconfig.sysbuild"
osource "/Users/moritzpohlandt/zephyrproject/zephyr/soc/nxp/mcx/Kconfig.sysbuild"
osource "/Users/moritzpohlandt/zephyrproject/zephyr/soc/nxp/lpc/Kconfig.sysbuild"
osource "/Users/moritzpohlandt/zephyrproject/zephyr/soc/nxp/layerscape/Kconfig.sysbuild"
osource "/Users/moritzpohlandt/zephyrproject/zephyr/soc/nxp/kinetis/Kconfig.sysbuild"
osource "/Users/moritzpohlandt/zephyrproject/zephyr/soc/nxp/imxrt/Kconfig.sysbuild"
osource "/Users/moritzpohlandt/zephyrproject/zephyr/soc/nxp/imx/Kconfig.sysbuild"
osource "/Users/moritzpohlandt/zephyrproject/zephyr/soc/nuvoton/numicro/Kconfig.sysbuild"
osource "/Users/moritzpohlandt/zephyrproject/zephyr/soc/nuvoton/numaker/Kconfig.sysbuild"
osource "/Users/moritzpohlandt/zephyrproject/zephyr/soc/nuvoton/npcx/Kconfig.sysbuild"
osource "/Users/moritzpohlandt/zephyrproject/zephyr/soc/nuvoton/npcm/Kconfig.sysbuild"
osource "/Users/moritzpohlandt/zephyrproject/zephyr/soc/nordic/Kconfig.sysbuild"
osource "/Users/moritzpohlandt/zephyrproject/zephyr/soc/neorv32/Kconfig.sysbuild"
osource "/Users/moritzpohlandt/zephyrproject/zephyr/soc/native/inf_clock/Kconfig.sysbuild"
osource "/Users/moritzpohlandt/zephyrproject/zephyr/soc/microchip/miv/Kconfig.sysbuild"
osource "/Users/moritzpohlandt/zephyrproject/zephyr/soc/microchip/mec/Kconfig.sysbuild"
osource "/Users/moritzpohlandt/zephyrproject/zephyr/soc/mediatek/mtk_adsp/Kconfig.sysbuild"
osource "/Users/moritzpohlandt/zephyrproject/zephyr/soc/lowrisc/opentitan/Kconfig.sysbuild"
osource "/Users/moritzpohlandt/zephyrproject/zephyr/soc/litex/litex_vexriscv/Kconfig.sysbuild"
osource "/Users/moritzpohlandt/zephyrproject/zephyr/soc/ite/ec/Kconfig.sysbuild"
osource "/Users/moritzpohlandt/zephyrproject/zephyr/soc/intel/raptor_lake/Kconfig.sysbuild"
osource "/Users/moritzpohlandt/zephyrproject/zephyr/soc/intel/lakemont/Kconfig.sysbuild"
osource "/Users/moritzpohlandt/zephyrproject/zephyr/soc/intel/intel_socfpga_std/Kconfig.sysbuild"
osource "/Users/moritzpohlandt/zephyrproject/zephyr/soc/intel/intel_socfpga/Kconfig.sysbuild"
osource "/Users/moritzpohlandt/zephyrproject/zephyr/soc/intel/intel_niosv/Kconfig.sysbuild"
osource "/Users/moritzpohlandt/zephyrproject/zephyr/soc/intel/intel_ish/Kconfig.sysbuild"
osource "/Users/moritzpohlandt/zephyrproject/zephyr/soc/intel/intel_adsp/Kconfig.sysbuild"
osource "/Users/moritzpohlandt/zephyrproject/zephyr/soc/intel/elkhart_lake/Kconfig.sysbuild"
osource "/Users/moritzpohlandt/zephyrproject/zephyr/soc/intel/atom/Kconfig.sysbuild"
osource "/Users/moritzpohlandt/zephyrproject/zephyr/soc/intel/apollo_lake/Kconfig.sysbuild"
osource "/Users/moritzpohlandt/zephyrproject/zephyr/soc/intel/alder_lake/Kconfig.sysbuild"
osource "/Users/moritzpohlandt/zephyrproject/zephyr/soc/infineon/cat3/Kconfig.sysbuild"
osource "/Users/moritzpohlandt/zephyrproject/zephyr/soc/infineon/cat1b/Kconfig.sysbuild"
osource "/Users/moritzpohlandt/zephyrproject/zephyr/soc/infineon/cat1a/Kconfig.sysbuild"
osource "/Users/moritzpohlandt/zephyrproject/zephyr/soc/gd/gd32/Kconfig.sysbuild"
osource "/Users/moritzpohlandt/zephyrproject/zephyr/soc/gaisler/leon3/Kconfig.sysbuild"
osource "/Users/moritzpohlandt/zephyrproject/zephyr/soc/gaisler/gr716a/Kconfig.sysbuild"
osource "/Users/moritzpohlandt/zephyrproject/zephyr/soc/espressif/Kconfig.sysbuild"
osource "/Users/moritzpohlandt/zephyrproject/zephyr/soc/ene/kb1200/Kconfig.sysbuild"
osource "/Users/moritzpohlandt/zephyrproject/zephyr/soc/efinix/sapphire/Kconfig.sysbuild"
osource "/Users/moritzpohlandt/zephyrproject/zephyr/soc/cdns/xtensa_sample_controller/Kconfig.sysbuild"
osource "/Users/moritzpohlandt/zephyrproject/zephyr/soc/cdns/sample_controller32/Kconfig.sysbuild"
osource "/Users/moritzpohlandt/zephyrproject/zephyr/soc/cdns/dc233c/Kconfig.sysbuild"
osource "/Users/moritzpohlandt/zephyrproject/zephyr/soc/brcm/bcmvk/Kconfig.sysbuild"
osource "/Users/moritzpohlandt/zephyrproject/zephyr/soc/brcm/bcm2712/Kconfig.sysbuild"
osource "/Users/moritzpohlandt/zephyrproject/zephyr/soc/brcm/bcm2711/Kconfig.sysbuild"
osource "/Users/moritzpohlandt/zephyrproject/zephyr/soc/atmel/sam0/Kconfig.sysbuild"
osource "/Users/moritzpohlandt/zephyrproject/zephyr/soc/atmel/sam/Kconfig.sysbuild"
osource "/Users/moritzpohlandt/zephyrproject/zephyr/soc/aspeed/Kconfig.sysbuild"
osource "/Users/moritzpohlandt/zephyrproject/zephyr/soc/arm/Kconfig.sysbuild"
osource "/Users/moritzpohlandt/zephyrproject/zephyr/soc/arm/beetle/Kconfig.sysbuild"
osource "/Users/moritzpohlandt/zephyrproject/zephyr/soc/andestech/Kconfig.sysbuild"
osource "/Users/moritzpohlandt/zephyrproject/zephyr/soc/ambiq/Kconfig.sysbuild"
osource "/Users/moritzpohlandt/zephyrproject/zephyr/soc/altr/zephyr_nios2f/Kconfig.sysbuild"
osource "/Users/moritzpohlandt/zephyrproject/zephyr/soc/altr/qemu_nios2/Kconfig.sysbuild"
osource "/Users/moritzpohlandt/zephyrproject/zephyr/soc/adi/max32/Kconfig.sysbuild"
```
