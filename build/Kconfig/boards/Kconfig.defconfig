## build/Kconfig/boards/Kconfig.defconfig
```kconfig
# Load Zephyr board defconfig descriptions.
osource "/Users/moritzpohlandt/zephyrproject/zephyr/boards/espressif/esp32_devkitc_wroom/Kconfig.defconfig"
```

## build/Kconfig/boards/Kconfig.esp32_devkitc_wroom
```kconfig
# Load board Kconfig descriptions.
osource "/Users/moritzpohlandt/zephyrproject/zephyr/boards/espressif/esp32_devkitc_wroom/Kconfig.esp32_devkitc_wroom"
```

## build/Kconfig/boards/Kconfig.sysbuild
```kconfig
# Load Sysbuild board Kconfig descriptions.
osource "/Users/moritzpohlandt/zephyrproject/zephyr/boards/espressif/esp32_devkitc_wroom/Kconfig.sysbuild"
```
